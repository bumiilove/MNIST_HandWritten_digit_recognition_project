#include <stdio.h>
#include <math.h>
#include <MLP_32_16_95.45_27.h>

#define WINPUT 784
#define HIDDEN1 32
#define HIDDEN2 16
#define WOUTPUT 10

float relu(float x);
void inference();

float conf_score = 0.00;
float input[WINPUT] = {
        0.0000, 0.0000, 0.0000, 0.0000, 0.0000, 0.0000, 0.0000, 0.0000, 0.0000,
         0.0000, 0.0000, 0.0000, 0.0000, 0.0000, 0.0000, 0.0000, 0.0000, 0.0000,
         0.0000, 0.0000, 0.0000, 0.0000, 0.0000, 0.0000, 0.0000, 0.0000, 0.0000,
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         0.0000, 0.0000, 0.0000, 0.0000, 0.0000, 0.0000, 0.0000, 0.0000, 0.0000,
         0.0000
  };

void setup() {
  Serial.begin(9600);
}

void loop() {
  inference();
  delay(3000);
}

float relu(float x)
{
  return (x > 0) * x;
}

void inference() {
  int inferenced_res = -1;

    float layer1[HIDDEN1] = { 0, };
    float layer2[HIDDEN2] = { 0, };
    float output[WOUTPUT] = { 0, };
    float max_out = 0;
    float exp_sum = 0;

    // ----------------- Inference ---------------------- //
    //if(label < 10){
    //input to layer1
    for (int x = 0; x < HIDDEN1; x++)
    {
        for (int y = 0; y < WINPUT; y++)
        {
            layer1[x] += w1[x][y] * input[y];
            //layer1[x] += w1[x][y] * input_ref[label][y];
        }
        layer1[x] += b1[x];
        layer1[x] = relu(layer1[x]);
    }
    //layer1 to layer2
    for (int x = 0; x < HIDDEN2; x++)
    {
        for (int y = 0; y < HIDDEN1; y++)
        {
            layer2[x] += w2[x][y] * layer1[y];
        }
        layer2[x] += b2[x];
        layer2[x] = relu(layer2[x]);
    }
    //layer2 to output
    for (int x = 0; x < WOUTPUT; x++)
    {
        for (int y = 0; y < HIDDEN2; y++)
        {
            output[x] += w3[x][y] * layer2[y];
        }
        output[x] += b3[x];
        output[x] = relu(output[x]);
    }
    //apply log_softmax to output
    for (int i = 0; i < WOUTPUT; i++)
    {
        if (max_out < output[i])
            max_out = output[i];
    }
    for (int i = 0; i < WOUTPUT; i++)
    {
        output[i] = (float)exp((double)output[i] - (double)max_out);
        exp_sum += output[i];
    }
    for (int i = 0; i < WOUTPUT; i++)
    {
        output[i] = output[i] / exp_sum;
    }

    Serial.println("\ninference!");
    //print output
    for (int i = 0; i < WOUTPUT; i++){
        Serial.print(i);
        Serial.print(" ");
        Serial.println(output[i]);
        
        if(output[i] > conf_score){
            conf_score = output[i];
            inferenced_res = i;
          }
    }
    // ----------------- Inference ---------------------- //

}
